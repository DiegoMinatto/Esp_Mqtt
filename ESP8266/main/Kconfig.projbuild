## ESP8266/main/Kconfig.projbuild
```kconfig
menu "Example Configuration"

    config ESP_WIFI_SSID
        string "WiFi SSID"
        default "myssid"
        help
            SSID (network name) for the example to connect to.

    config ESP_WIFI_PASSWORD
        string "WiFi Password"
        default "mypassword"
        help
            WiFi password (WPA or WPA2) for the example to use.

    config ESP_MAXIMUM_RETRY
        int "Maximum retry"
        default 5
        help
            Set the Maximum retry to avoid station reconnecting to the AP unlimited when the AP is really inexistent.

config BROKER_URI
    string "Broker URL"
    default "mqtts://iot.eclipse.org:8883"
    help
        URL of an mqtt broker which this example connects to.

config BROKER_CERTIFICATE_OVERRIDE
    string "Broker certificate override"
    default ""
    help
        Please leave empty if broker certificate included from a textfile; otherwise fill in a base64 part of PEM format certificate
		
config BROKER_CERTIFICATE_OVERRIDDEN
    bool
    default y if BROKER_CERTIFICATE_OVERRIDE != ""

endmenu
```
